## CMakeLists.txt
```
# Copyright (c) 2022-2023 Golioth, Inc.
# SPDX-License-Identifier: Apache-2.0

cmake_minimum_required(VERSION 3.20.0)

find_package(Zephyr REQUIRED HINTS $ENV{ZEPHYR_BASE})

project(thingy91_golioth)

target_sources(app PRIVATE src/main.c)
target_sources(app PRIVATE src/app_buzzer.c)
target_sources(app PRIVATE src/app_rpc.c)
target_sources(app PRIVATE src/app_settings.c)
target_sources(app PRIVATE src/app_state.c)
target_sources(app PRIVATE src/app_sensors.c)
```

## west.yml
```
# Copyright (c) 2022-2023 Golioth, Inc.
# SPDX-License-Identifier: Apache-2.0

manifest:
  version: 1.0

  group-filter:
    - +bsec

  projects:
    - name: golioth
      path: modules/lib/golioth-firmware-sdk
      revision: v0.21.0
      url: https://github.com/golioth/golioth-firmware-sdk.git
      west-commands: scripts/west-commands.yml
      submodules: true
      import:
        file: west-ncs.yml
        path-prefix: deps
        name-allowlist:
          - nrf
          - zephyr
          - bme68x
          - bsec
          - cmsis_6
          - hal_nordic
          - mbedtls
          - mbedtls-nrf
          - mcuboot
          - net-tools
          - nrfxlib
          - oberon-psa-crypto
          - qcbor
          - segger
          - tfm-mcuboot
          - tinycrypt
          - trusted-firmware-m
          - zcbor

    - name: golioth-zephyr-boards
      path: deps/modules/lib/golioth-boards
      revision: v2.1.1
      url: https://github.com/golioth/golioth-zephyr-boards

    - name: zephyr-network-info
      path: deps/modules/lib/network-info
      revision: szczys/add-imsi
      url: https://github.com/golioth/zephyr-network-info

    - name: golioth-battery-monitor
      path: deps/modules/lib/battery-monitor
      revision: v1.1.0
      url: https://github.com/golioth/battery-monitor

  self:
    path: app
```

## prj.conf
```kconfig
# Copyright (c) 2022-2023 Golioth, Inc.
# SPDX-License-Identifier: Apache-2.0

# Enable Golioth Firmware SDK
CONFIG_GOLIOTH_FIRMWARE_SDK=y

# Golioth services used in this app
CONFIG_GOLIOTH_FW_UPDATE=y
CONFIG_GOLIOTH_LIGHTDB_STATE=y
CONFIG_LOG_BACKEND_GOLIOTH=y
CONFIG_GOLIOTH_RPC=y
CONFIG_GOLIOTH_SETTINGS=y
CONFIG_GOLIOTH_STREAM=y

# Enable common sample library
CONFIG_GOLIOTH_SAMPLE_COMMON=y

# Configure Golioth SDK dependencies
CONFIG_ZVFS_EVENTFD_MAX=14
CONFIG_ZVFS_OPEN_MAX=23
CONFIG_LOG_PROCESS_THREAD_STACK_SIZE=1536
CONFIG_MBEDTLS_ENABLE_HEAP=y
CONFIG_MBEDTLS_HEAP_SIZE=10240
CONFIG_NETWORKING=y
CONFIG_NET_IPV4=y
CONFIG_COAP_EXTENDED_OPTIONS_LEN=y
CONFIG_COAP_EXTENDED_OPTIONS_LEN_VALUE=39

# Application
CONFIG_MAIN_STACK_SIZE=3072
CONFIG_NET_LOG=y
CONFIG_SHELL=y
CONFIG_REBOOT=y

# Flash memory (etc.) for firmware upgrade
CONFIG_FLASH=y
CONFIG_FLASH_MAP=y
CONFIG_NVS=y
CONFIG_STREAM_FLASH=y
CONFIG_IMG_MANAGER=y
CONFIG_IMG_ERASE_PROGRESSIVELY=y
CONFIG_REBOOT=y

# The rest of the runtime credentials config
CONFIG_SETTINGS=y
CONFIG_SETTINGS_RUNTIME=y
CONFIG_GOLIOTH_SAMPLE_SETTINGS_AUTOLOAD=y
CONFIG_GOLIOTH_SAMPLE_SETTINGS_SHELL=y

# Longer response length needed for network info
CONFIG_GOLIOTH_RPC_MAX_RESPONSE_LEN=512
CONFIG_I2C=y
CONFIG_SENSOR=y

CONFIG_PWM=y
CONFIG_PWM_LOG_LEVEL_DBG=n

# Disable unused libraries to save flash
CONFIG_FLASH_SHELL=n
CONFIG_SENSOR_SHELL=n
```

## boards/thingy91_nrf9160_ns.conf
```kconfig
# Copyright (c) 2024 Golioth, Inc.
# SPDX-License-Identifier: Apache-2.0

CONFIG_BH1749=y
CONFIG_BH1749_TRIGGER=y

CONFIG_BME680=y

CONFIG_ADXL362=y
CONFIG_ADXL362_TRIGGER_GLOBAL_THREAD=y
CONFIG_ADXL362_INTERRUPT_MODE=1
CONFIG_ADXL362_ABS_REF_MODE=1
CONFIG_ADXL362_ACCEL_RANGE_2G=y
CONFIG_ADXL362_ACCEL_ODR_12_5=y

# Disable unused libraries to save flash
CONFIG_ADXL372=n

# Use a unique package name to use with Pacakges/Cohorts/Deployments
CONFIG_GOLIOTH_FW_UPDATE_PACKAGE_NAME="thingy91"
```

## boards/thingy91x_nrf9151_ns.conf
```kconfig
# Copyright (c) 2024 Golioth, Inc.
# SPDX-License-Identifier: Apache-2.0

CONFIG_BME680=n
CONFIG_BME68X_IAQ=y
CONFIG_BME68X_IAQ_THREAD_STACK_SIZE=2048
CONFIG_BME68X_IAQ_SAMPLE_RATE_LOW_POWER=y

# Use a unique package name to use with Pacakges/Cohorts/Deployments
CONFIG_GOLIOTH_FW_UPDATE_PACKAGE_NAME="thingy91x"
```

## socs/nrf9160_ns.conf
```kconfig
# Copyright (c) 2024 Golioth, Inc.
# SPDX-License-Identifier: Apache-2.0

# General config
CONFIG_HEAP_MEM_POOL_SIZE=4096
CONFIG_NEWLIB_LIBC=y

# Networking
CONFIG_NET_SOCKETS_OFFLOAD=y
CONFIG_NET_IPV6=y
CONFIG_NET_IPV6_NBR_CACHE=n
CONFIG_NET_IPV6_MLD=n

# Increase native TLS socket implementation, so that it is chosen instead of
# offloaded nRF91 sockets
CONFIG_NET_SOCKETS_TLS_PRIORITY=35

# Modem library
CONFIG_NRF_MODEM_LIB=y

# LTE connectivity with network connection manager
CONFIG_NRF_MODEM_LIB_NET_IF=y
CONFIG_NRF_MODEM_LIB_NET_IF_AUTO_START=y
CONFIG_NRF_MODEM_LIB_NET_IF_AUTO_CONNECT=n
CONFIG_NET_CONNECTION_MANAGER=y
CONFIG_NET_CONNECTION_MANAGER_MONITOR_STACK_SIZE=1024

# Add Logs for LTE Link Handler
CONFIG_GOLIOTH_SAMPLE_NRF91_LTE_MONITOR=y

# Disable options y-selected by NCS for no good reason
CONFIG_MBEDTLS_KEY_EXCHANGE_DHE_PSK_ENABLED=n
CONFIG_MBEDTLS_KEY_EXCHANGE_DHE_RSA_ENABLED=n

# MbedTLS configuration to support p-384 curve. These options
# enable using the MbedTLS built-in support for operations not
# supported by the default nRF Oberon crypto backend
CONFIG_NORDIC_SECURITY_BACKEND=n
CONFIG_MBEDTLS_LEGACY_CRYPTO_C=y

# Add Network Info Support
CONFIG_MODEM_INFO=y

# Generate MCUboot compatible images
CONFIG_BOOTLOADER_MCUBOOT=y
```

## boards/thingy91_nrf9160_ns.overlay
```dts
/ {
	aliases {
		sw1 = &button0;
		buzzer-pwm = &buzzer;
	};
	pwmbuzzer {
		compatible = "pwm-leds";
		status = "okay";

		buzzer: buzzer_pwm {
			pwms = <&pwm1 0 PWM_HZ(880) PWM_POLARITY_NORMAL>;
			label = "PWM_1";
		};
	};
};
```

## boards/thingy91x_nrf9151_ns.overlay
```dts
/ {
	aliases {
		sw1 = &button0;
	};
};

&bme680 {
	status = "okay";
};

&accel {
	status = "okay";
};
```

## src/main.c
```c
/*
 * Copyright (c) 2022-2023 Golioth, Inc.
 *
 * SPDX-License-Identifier: Apache-2.0
 */

#include <zephyr/logging/log.h>
LOG_MODULE_REGISTER(thingy91_golioth, LOG_LEVEL_DBG);

#include <app_version.h>
#include "app_buzzer.h"
#include "app_rpc.h"
#include "app_settings.h"
#include "app_state.h"
#include "app_sensors.h"
#include <golioth/client.h>
#include <golioth/stream.h>
#include <golioth/fw_update.h>
#include <samples/common/net_connect.h>
#include <samples/common/sample_credentials.h>
#include <zephyr/kernel.h>

#ifdef CONFIG_SOC_SERIES_NRF91X
#include <modem/lte_lc.h>
#endif

#include <zephyr/drivers/gpio.h>

#ifdef CONFIG_MODEM_INFO
#include <modem/modem_info.h>
#endif

/* Current firmware version; update in VERSION */
static const char *_current_version =
	STRINGIFY(APP_VERSION_MAJOR) "." STRINGIFY(APP_VERSION_MINOR) "." STRINGIFY(APP_PATCHLEVEL);

static struct golioth_client *client;
K_SEM_DEFINE(connected, 0, 1);

static k_tid_t _system_thread;

static const struct gpio_dt_spec user_btn = GPIO_DT_SPEC_GET(DT_ALIAS(sw1), gpios);
static struct gpio_callback button_cb_data;

void wake_system_thread(void)
{
	k_wakeup(_system_thread);
}

static void on_client_event(struct golioth_client *client, enum golioth_client_event event,
			    void *arg)
{
	bool is_connected = (event == GOLIOTH_CLIENT_EVENT_CONNECTED);

	if (is_connected) {
		k_sem_give(&connected);
		app_led_pwm_init();
	}
	LOG_INF("Golioth client %s", is_connected ? "connected" : "disconnected");
}

static void start_golioth_client(void)
{
	/* Get the client configuration from auto-loaded settings */
	const struct golioth_client_config *client_config = golioth_sample_credentials_get();

	/* Create and start a Golioth Client */
	client = golioth_client_create(client_config);

	/* Register Golioth on_connect callback */
	golioth_client_register_event_callback(client, on_client_event, NULL);

	/* Initialize DFU components */
	golioth_fw_update_init(client, _current_version);

	/*** Call Golioth APIs for other services in dedicated app files ***/

	/* Observe State service data */
	app_state_observe(client);

	/* Set Golioth Client for streaming sensor data */
	app_sensors_set_client(client);

	/* Register Settings service */
	app_settings_register(client);

	/* Register RPC service */
	app_rpc_register(client);
}

#ifdef CONFIG_SOC_SERIES_NRF91X

static void lte_handler(const struct lte_lc_evt *const evt)
{
	if (evt->type == LTE_LC_EVT_NW_REG_STATUS) {

		if ((evt->nw_reg_status == LTE_LC_NW_REG_REGISTERED_HOME) ||
		    (evt->nw_reg_status == LTE_LC_NW_REG_REGISTERED_ROAMING)) {

			/* Change the state of the Internet LED on Ostentus */
			IF_ENABLED(CONFIG_LIB_OSTENTUS, (ostentus_led_internet_set(o_dev, 1);));

			if (!client) {
				/* Create and start a Golioth Client */
				start_golioth_client();
			}
		}
	}
}

#endif /* CONFIG_SOC_SERIES_NRF91X */

#ifdef CONFIG_MODEM_INFO
static void log_modem_firmware_version(void)
{
	char sbuf[128];

	/* Initialize modem info */
	int err = modem_info_init();

	if (err) {
		LOG_ERR("Failed to initialize modem info: %d", err);
		return;
	}

	/* Log modem firmware version */
	modem_info_string_get(MODEM_INFO_FW_VERSION, sbuf, sizeof(sbuf));
	LOG_INF("Modem firmware version: %s", sbuf);
}
#endif

void button_pressed(const struct device *dev, struct gpio_callback *cb, uint32_t pins)
{
	uint32_t button_kernel_time = k_cycle_get_32();

	LOG_DBG("Button pressed at %d", button_kernel_time);

	play_beep_once();
	k_wakeup(_system_thread);
}

int main(void)
{
	int err;

	LOG_DBG("Start Thingy91 Golioth sample");

	LOG_INF("Firmware version: %s", _current_version);
	IF_ENABLED(CONFIG_MODEM_INFO, (log_modem_firmware_version();));

	/* Get system thread id so loop delay change event can wake main */
	_system_thread = k_current_get();

#ifdef CONFIG_SOC_SERIES_NRF91X
	/* Start LTE asynchronously if the nRF9160 is used.
	 * Golioth Client will start automatically when LTE connects
	 */

	LOG_INF("Connecting to LTE, this may take some time...");
	lte_lc_connect_async(lte_handler);

#else
	/* If nRF9160 is not used, start the Golioth Client and block until connected */

	/* Start Golioth client */
	golioth_system_client_start();

	/* Block until connected to Golioth */
	k_sem_take(&connected, K_FOREVER);

	/* Start Golioth client */
	start_golioth_client();

	/* Block until connected to Golioth */
	k_sem_take(&connected, K_FOREVER);
#endif /* CONFIG_SOC_SERIES_NRF91X */

	err = app_buzzer_init();
	if (err) {
		LOG_ERR("Unable to configure buzzer");
	}

	/* Set up user button */
	err = gpio_pin_configure_dt(&user_btn, GPIO_INPUT);
	if (err) {
		LOG_ERR("Error %d: failed to configure %s pin %d", err, user_btn.port->name,
			user_btn.pin);
		return err;
	}

	err = gpio_pin_interrupt_configure_dt(&user_btn, GPIO_INT_EDGE_TO_ACTIVE);
	if (err) {
		LOG_ERR("Error %d: failed to configure interrupt on %s pin %d", err,
			user_btn.port->name, user_btn.pin);
		return err;
	}

	gpio_init_callback(&button_cb_data, button_pressed, BIT(user_btn.pin));
	gpio_add_callback(user_btn.port, &button_cb_data);

	while (true) {
		app_sensors_read_and_stream();
		app_state_counter_change();

		k_sleep(K_SECONDS(get_loop_delay_s()));
	}
}
```

## src/app_buzzer.c
```c
/*
 * Copyright (c) 2024 Golioth, Inc.
 *
 * SPDX-License-Identifier: Apache-2.0
 */

#if defined(CONFIG_BOARD_THINGY91_NRF9160_NS)

#include <zephyr/logging/log.h>
LOG_MODULE_REGISTER(app_buzzer, LOG_LEVEL_DBG);

#include <stdlib.h>
#include <zephyr/device.h>
#include <zephyr/drivers/pwm.h>
#include <zephyr/kernel.h>

#define FUNKYTOWN_NOTES 13
#define MARIO_NOTES	37
#define GOLIOTH_NOTES	21

#define BUZZER_MAX_FREQ 2500
#define BUZZER_MIN_FREQ 75

#define sixteenth 38
#define eigth	  75
#define quarter	  150
#define half	  300
#define whole	  600

#define C4  262
#define Db4 277
#define D4  294
#define Eb4 311
#define E4  330
#define F4  349
#define Gb4 370
#define G4  392
#define Ab4 415
#define A4  440
#define Bb4 466
#define B4  494
#define C5  523
#define Db5 554
#define D5  587
#define Eb5 622
#define E5  659
#define F5  698
#define Gb5 740
#define G5  784
#define Ab5 831
#define A5  880
#define Bb5 932
#define B5  988
#define C6  1046
#define Db6 1109
#define D6  1175
#define Eb6 1245
#define E6  1319
#define F6  1397
#define Gb6 1480
#define G6  1568
#define Ab6 1661
#define A6  1760
#define Bb6 1865
#define B6  1976

#define REST 1

static const struct pwm_dt_spec sBuzzer = PWM_DT_SPEC_GET(DT_ALIAS(buzzer_pwm));

enum song_choice {
	beep,
	funkytown,
	mario,
	golioth
};

enum song_choice song = 3;

struct note_duration {
	int note;     /* hz */
	int duration; /* msec */
};

static struct note_duration funkytown_song[FUNKYTOWN_NOTES] = {
	{.note = C5, .duration = quarter},
	{.note = REST, .duration = eigth},
	{.note = C5, .duration = quarter},
	{.note = Bb4, .duration = quarter},
	{.note = C5, .duration = quarter},
	{.note = REST, .duration = quarter},
	{.note = G4, .duration = quarter},
	{.note = REST, .duration = quarter},
	{.note = G4, .duration = quarter},
	{.note = C5, .duration = quarter},
	{.note = F5, .duration = quarter},
	{.note = E5, .duration = quarter},
	{.note = C5, .duration = quarter}};

static struct note_duration mario_song[MARIO_NOTES] = {
	{.note = E6, .duration = quarter},
	{.note = REST, .duration = eigth},
	{.note = E6, .duration = quarter},
	{.note = REST, .duration = quarter},
	{.note = E6, .duration = quarter},
	{.note = REST, .duration = quarter},
	{.note = C6, .duration = quarter},
	{.note = E6, .duration = half},
	{.note = G6, .duration = half},
	{.note = REST, .duration = quarter},
	{.note = G4, .duration = whole},
	{.note = REST, .duration = whole},
	/* break in sound */
	{.note = C6, .duration = half},
	{.note = REST, .duration = quarter},
	{.note = G5, .duration = half},
	{.note = REST, .duration = quarter},
	{.note = E5, .duration = half},
	{.note = REST, .duration = quarter},
	{.note = A5, .duration = quarter},
	{.note = REST, .duration = quarter},
	{.note = B5, .duration = quarter},
	{.note = REST, .duration = quarter},
	{.note = Bb5, .duration = quarter},
	{.note = A5, .duration = half},
	{.note = G5, .duration = quarter},
	{.note = E6, .duration = quarter},
	{.note = G6, .duration = quarter},
	{.note = A6, .duration = half},
	{.note = F6, .duration = quarter},
	{.note = G6, .duration = quarter},
	{.note = REST, .duration = quarter},
	{.note = E6, .duration = quarter},
	{.note = REST, .duration = quarter},
	{.note = C6, .duration = quarter},
	{.note = D6, .duration = quarter},
	{.note = B5, .duration = quarter}};

static struct note_duration golioth_song[] = {
	{.note = C6, .duration = quarter},
	{.note = REST, .duration = 100},
	{.note = G5, .duration = 100},
	{.note = A5, .duration = 100},
	{.note = Bb5, .duration = 100},
	{.note = REST, .duration = 100},
	{.note = Bb5, .duration = 100},
	{.note = REST, .duration = quarter},
	{.note = C5, .duration = half},
	{.note = REST, .duration = half},
	{.note = REST, .duration = quarter},
	{.note = C6, .duration = quarter}
};

/* Thread plays song on buzzer */

K_SEM_DEFINE(buzzer_initialized_sem, 0, 1); /* Wait until buzzer is ready */

#define BUZZER_STACK 1024

extern void buzzer_thread(void *d0, void *d1, void *d2)
{
	/* Block until buzzer is available */
	k_sem_take(&buzzer_initialized_sem, K_FOREVER);
	while (1) {
		switch (song) {
		case 0:
			LOG_DBG("beep");
			pwm_set_dt(&sBuzzer, PWM_HZ(1000), PWM_HZ(1000) / 2);
			k_msleep(100);
			break;
		case 1:
			LOG_DBG("funkytown");
			for (int i = 0; i < FUNKYTOWN_NOTES; i++) {
				if (funkytown_song[i].note < 10) {
					/* Low frequency notes represent a 'pause' */
					pwm_set_pulse_dt(&sBuzzer, 0);
					k_msleep(funkytown_song[i].duration);
				} else {
					pwm_set_dt(&sBuzzer, PWM_HZ(funkytown_song[i].note),
						   PWM_HZ((funkytown_song[i].note)) / 2);
					k_msleep(funkytown_song[i].duration);
				}
			}
			break;

		case 2:
			LOG_DBG("mario");
			for (int i = 0; i < MARIO_NOTES; i++) {
				if (mario_song[i].note < 10) {
					/* Low frequency notes represent a 'pause' */
					pwm_set_pulse_dt(&sBuzzer, 0);
					k_msleep(mario_song[i].duration);
				} else {
					pwm_set_dt(&sBuzzer, PWM_HZ(mario_song[i].note),
						   PWM_HZ((mario_song[i].note)) / 2);
					k_msleep(mario_song[i].duration);
				}
			}
			break;
		case 3:
			LOG_DBG("golioth");
			for (int i = 0; i < (sizeof(golioth_song) / sizeof(golioth_song[1])); i++) {
				if (golioth_song[i].note < 10) {
					/* Low frequency notes represent a 'pause' */
					pwm_set_pulse_dt(&sBuzzer, 0);
					k_msleep(golioth_song[i].duration);
				} else {
					pwm_set_dt(&sBuzzer, PWM_HZ(golioth_song[i].note),
						   PWM_HZ((golioth_song[i].note)) / 2);
					k_msleep(golioth_song[i].duration);
				}
			}
			break;
		default:
			LOG_WRN("invalid switch state");
			break;
		}

		/* turn buzzer off (pulse duty to 0) */
		pwm_set_pulse_dt(&sBuzzer, 0);

		/* Sleep thread until awoken externally */
		k_sleep(K_FOREVER);
	}
}

int app_buzzer_init(void)
{
	if (!device_is_ready(sBuzzer.dev)) {
		return -ENODEV;
	}
	k_sem_give(&buzzer_initialized_sem);
	return 0;
}

K_THREAD_DEFINE(buzzer_tid, BUZZER_STACK, buzzer_thread, NULL, NULL, NULL,
		K_LOWEST_APPLICATION_THREAD_PRIO, 0, 0);

void play_beep_once(void)
{
	song = beep;
	k_wakeup(buzzer_tid);
}

void play_funkytown_once(void)
{
	song = funkytown;
	k_wakeup(buzzer_tid);
}

void play_mario_once(void)
{
	song = mario;
	k_wakeup(buzzer_tid);
}

void play_golioth_once(void)
{
	song = golioth;
	k_wakeup(buzzer_tid);
}

#else

int app_buzzer_init(void)
{
	return 0;
}

void play_beep_once(void)
{
	return;
}

#endif /* CONFIG_BOARD_THINGY91_NRF9160_NS */
```

## src/app_buzzer.h
```c
/*
 * Copyright (c) 2024 Golioth, Inc.
 *
 * SPDX-License-Identifier: Apache-2.0
 */

#ifndef __APP_BUZZER_H__
#define __APP_BUZZER_H__

int app_buzzer_init(void);
void play_beep_once(void);

#if defined(CONFIG_BOARD_THINGY91_NRF9160_NS)
void play_funkytown_once(void);
void play_mario_once(void);
void play_golioth_once(void);
#endif /* CONFIG_BOARD_THINGY91_NRF9160_NS */

#endif /* __APP_BUZZER__H__ */
```

## src/app_rpc.c
```c
/*
 * Copyright (c) 2022-2023 Golioth, Inc.
 *
 * SPDX-License-Identifier: Apache-2.0
 */

#include <zephyr/logging/log.h>
LOG_MODULE_REGISTER(app_rpc, LOG_LEVEL_DBG);

#include <golioth/client.h>
#include <golioth/rpc.h>
#include <zephyr/logging/log_ctrl.h>
#include <zephyr/sys/reboot.h>

#ifdef CONFIG_NETWORK_INFO
#include <network_info.h>
#endif

#include "app_buzzer.h"
#include "app_rpc.h"

static void reboot_work_handler(struct k_work *work)
{
	for (int8_t i = 5; i >= 0; i--) {
		if (i) {
			LOG_INF("Rebooting in %d seconds...", i);
		}
		k_sleep(K_SECONDS(1));
	}

	/* Sync logs before reboot */
	LOG_PANIC();

	sys_reboot(SYS_REBOOT_COLD);
}
K_WORK_DEFINE(reboot_work, reboot_work_handler);

static enum golioth_rpc_status on_get_network_info(zcbor_state_t *request_params_array,
						   zcbor_state_t *response_detail_map,
						   void *callback_arg)
{
	COND_CODE_1(CONFIG_NETWORK_INFO,
		    (network_info_add_to_map(response_detail_map); return GOLIOTH_RPC_OK;),
		    (return GOLIOTH_RPC_UNIMPLEMENTED););
}

static enum golioth_rpc_status on_set_log_level(zcbor_state_t *request_params_array,
						zcbor_state_t *response_detail_map,
						void *callback_arg)
{
	double param_0;
	uint8_t log_level;
	bool ok;

	LOG_WRN("on_set_log_level");

	ok = zcbor_float_decode(request_params_array, &param_0);
	if (!ok) {
		LOG_ERR("Failed to decode array item");
		return GOLIOTH_RPC_INVALID_ARGUMENT;
	}

	log_level = (uint8_t)param_0;

	if ((log_level < 0) || (log_level > LOG_LEVEL_DBG)) {

		LOG_ERR("Requested log level is out of bounds: %d", log_level);
		return GOLIOTH_RPC_INVALID_ARGUMENT;
	}

	int source_id = 0;
	char *source_name;

	while (1) {
		source_name = (char *)log_source_name_get(0, source_id);
		if (source_name == NULL) {
			break;
		}

		log_filter_set(NULL, 0, source_id, log_level);
		++source_id;
	}

	LOG_WRN("Log levels for %d modules set to: %d", source_id, log_level);

	ok = zcbor_tstr_put_lit(response_detail_map, "log_modules") &&
	     zcbor_float64_put(response_detail_map, (double)source_id);

	return GOLIOTH_RPC_OK;
}

static enum golioth_rpc_status on_play_song(zcbor_state_t *request_params_array,
					    zcbor_state_t *response_detail_map,
					    void *callback_arg)
{
#if defined(CONFIG_BOARD_THINGY91_NRF9160_NS)

	bool ok;
	char cbor_str[128];
	struct zcbor_string str_decode = {
		.value = cbor_str,
		.len = 0
	};

	ok = zcbor_tstr_decode(request_params_array, &str_decode);
	if (!ok) {
		LOG_ERR("Failed to decode RPC string argument");
		return GOLIOTH_RPC_INVALID_ARGUMENT;
	}

	uint8_t sbuf[str_decode.len + 1];

	snprintk(sbuf, sizeof(sbuf), "%s", str_decode.value);
	LOG_DBG("Received argument '%s' from 'play_song' RPC", sbuf);

	if (strcmp(sbuf, "beep") == 0) {
		play_beep_once();
	} else if (strcmp(sbuf, "funkytown") == 0) {
		play_funkytown_once();
	} else if (strcmp(sbuf, "mario") == 0) {
		play_mario_once();
	} else if (strcmp(sbuf, "golioth") == 0) {
		play_golioth_once();
	} else {
		LOG_ERR("'%s' is not an available song on your Thingy91", sbuf);

		ok = zcbor_tstr_put_lit(response_detail_map, "unknown song") &&
		     zcbor_tstr_put_term(response_detail_map, sbuf, sizeof(sbuf));
		return GOLIOTH_RPC_INVALID_ARGUMENT;
	}

	ok = zcbor_tstr_put_lit(response_detail_map, "playing song") &&
	     zcbor_tstr_put_term(response_detail_map, sbuf, sizeof(sbuf));
	return GOLIOTH_RPC_OK;

#else

	return GOLIOTH_RPC_UNIMPLEMENTED;

#endif /* CONFIG_BOARD_THINGY91_NRF9160_NS */
}

static enum golioth_rpc_status on_reboot(zcbor_state_t *request_params_array,
					 zcbor_state_t *response_detail_map, void *callback_arg)
{
	/* Use work queue so this RPC can return confirmation to Golioth */
	k_work_submit(&reboot_work);

	return GOLIOTH_RPC_OK;
}

static void rpc_log_if_register_failure(int err)
{
	if (err) {
		LOG_ERR("Failed to register RPC: %d", err);
	}
}

void app_rpc_register(struct golioth_client *client)
{
	struct golioth_rpc *rpc = golioth_rpc_init(client);

	int err;

	err = golioth_rpc_register(rpc, "get_network_info", on_get_network_info, NULL);
	rpc_log_if_register_failure(err);

	err = golioth_rpc_register(rpc, "reboot", on_reboot, NULL);
	rpc_log_if_register_failure(err);

	err = golioth_rpc_register(rpc, "set_log_level", on_set_log_level, NULL);
	rpc_log_if_register_failure(err);

	err = golioth_rpc_register(rpc, "play_song", on_play_song, NULL);
	rpc_log_if_register_failure(err);
}
```

## src/app_rpc.h
```c
/*
 * Copyright (c) 2022-2023 Golioth, Inc.
 *
 * SPDX-License-Identifier: Apache-2.0
 */

#ifndef __APP_RPC_H__
#define __APP_RPC_H__

#include <golioth/client.h>

void app_rpc_register(struct golioth_client *client);

#endif /* __APP_RPC_H__ */
```

## src/app_sensors.c
```c
/*
 * Copyright (c) 2022-2023 Golioth, Inc.
 *
 * SPDX-License-Identifier: Apache-2.0
 */

#include <zephyr/logging/log.h>
LOG_MODULE_REGISTER(app_sensors, LOG_LEVEL_DBG);

#include <stdlib.h>
#include <golioth/client.h>
#include <golioth/stream.h>
#include <zcbor_encode.h>
#include <zephyr/drivers/gpio.h>
#include <zephyr/drivers/sensor.h>
#include <zephyr/device.h>
#include <zcbor_encode.h>

#include "app_sensors.h"
#include "app_settings.h"

#ifdef CONFIG_NETWORK_INFO
#include <network_info.h>
#endif

static struct golioth_client *client;

/* Sensor device structs */
#if defined(CONFIG_BOARD_THINGY91_NRF9160_NS)
const struct device *light = DEVICE_DT_GET_ONE(rohm_bh1749);
const struct device *weather = DEVICE_DT_GET_ONE(bosch_bme680);
const struct device *accel = DEVICE_DT_GET_ONE(adi_adxl362);
#endif

#if defined(CONFIG_BOARD_THINGY91X_NRF9151_NS)
#include <drivers/bme68x_iaq.h>
const struct device *weather = DEVICE_DT_GET_ONE(bosch_bme680);
const struct device *accel = DEVICE_DT_GET_ONE(adi_adxl367);
#endif

/* Callback for LightDB Stream */
static void async_error_handler(struct golioth_client *client, enum golioth_status status,
				const struct golioth_coap_rsp_code *coap_rsp_code, const char *path,
				void *arg)
{
	if (status != GOLIOTH_OK) {
		LOG_ERR("Async task failed: %d", status);
		return;
	}
}

void stream_network_info(void)
{
#ifdef CONFIG_NETWORK_INFO
	uint8_t cbor_buf[512];
	ZCBOR_STATE_E(zse, 1, cbor_buf, sizeof(cbor_buf), 1);

	bool ok = zcbor_map_start_encode(zse, 1);
	if (false == ok)
	{
		LOG_ERR("Failed to start network info map");
		return;
	}

	network_info_add_to_map(zse);

	ok = zcbor_map_end_encode(zse, 1);
	if (false == ok)
	{
		LOG_ERR("Failed to end network info map");
		return;
	}

	size_t cbor_size = zse->payload - cbor_buf;

	int err = golioth_stream_set_async(client, "network", GOLIOTH_CONTENT_TYPE_CBOR, cbor_buf,
				cbor_size, async_error_handler, NULL);
	if (err) {
		LOG_ERR("Failed to send sensor data to Golioth: %d", err);
	}
#else
	LOG_DBG("Streaming network info unimplented in this build.");
#endif

}

static enum golioth_status read_light_sensor(zcbor_state_t *zse)
{
#if defined(CONFIG_DT_HAS_ROHM_BH1749_ENABLED)

	struct sensor_value BH1749_RED;
	struct sensor_value BH1749_GREEN;
	struct sensor_value BH1749_BLUE;
	struct sensor_value BH1749_IR;
	bool ok;

	/* Turn off LED so light sensor won't detect LED fade
	 * Also helps highlight that there is a reading being taken.
	 */
	all_leds_off();

	/* briefly sleep the thread to give time to run the LED thread */
	k_msleep(300);

	/* Start taking readings */

	/* BH1749 */
	int err = sensor_sample_fetch(light);

	all_leds_on();

	if (err) {
		LOG_ERR("Error fetching BH1749 sensor sample: %d", err);
		return GOLIOTH_ERR_FAIL;
	}
	sensor_channel_get(light, SENSOR_CHAN_RED, &BH1749_RED);
	sensor_channel_get(light, SENSOR_CHAN_GREEN, &BH1749_GREEN);
	sensor_channel_get(light, SENSOR_CHAN_BLUE, &BH1749_BLUE);
	sensor_channel_get(light, SENSOR_CHAN_IR, &BH1749_IR);
	LOG_DBG("R: %d, G: %d, B: %d, IR: %d", BH1749_RED.val1, BH1749_GREEN.val1, BH1749_BLUE.val1,
		BH1749_IR.val1);

	ok = zcbor_tstr_put_lit(zse, "light") && zcbor_map_start_encode(zse, 4);
	if (!ok)
	{
		LOG_ERR("ZCBOR unable to open light map");
		return GOLIOTH_ERR_QUEUE_FULL;
	}

	ok = zcbor_tstr_put_lit(zse, "red") &&
	     zcbor_float64_put(zse, sensor_value_to_double(&BH1749_RED)) &&
	     zcbor_tstr_put_lit(zse, "green") &&
	     zcbor_float64_put(zse, sensor_value_to_double(&BH1749_GREEN)) &&
	     zcbor_tstr_put_lit(zse, "blue") &&
	     zcbor_float64_put(zse, sensor_value_to_double(&BH1749_BLUE)) &&
	     zcbor_tstr_put_lit(zse, "ir") &&
	     zcbor_float64_put(zse, sensor_value_to_double(&BH1749_IR));
	if (!ok)
	{
		LOG_ERR("ZCBOR failed to encode light data");
		return GOLIOTH_ERR_QUEUE_FULL;
	}

	ok = zcbor_map_end_encode(zse, 4);
	if (!ok)
	{
		LOG_ERR("ZCBOR failed to close light map");
		return GOLIOTH_ERR_QUEUE_FULL;
	}

	return GOLIOTH_OK;

#else

	return GOLIOTH_OK;

#endif /* CONFIG_DT_HAS_ROHM_BH1749_ENABLED */
}


/* This function assume that sensor_sample_fetch() has already been run */
static enum golioth_status process_gas_sensor(zcbor_state_t *zse)
{
#if defined(CONFIG_BOARD_THINGY91_NRF9160_NS)

	struct sensor_value gas_res;
	bool ok;

	sensor_channel_get(weather, SENSOR_CHAN_GAS_RES, &gas_res);
	LOG_DBG("G: %d.%06d", gas_res.val1, gas_res.val2);

	ok = zcbor_tstr_put_lit(zse, "gas") &&
	     zcbor_float64_put(zse, sensor_value_to_double(&gas_res));

	if (!ok)
	{
		LOG_ERR("ZCBOR unable to encode gas data");
		return GOLIOTH_ERR_QUEUE_FULL;
	}

	return GOLIOTH_OK;

#elif defined(CONFIG_BOARD_THINGY91X_NRF9151_NS)

	struct sensor_value gas_iaq = { 0 };
	struct sensor_value gas_co2 = { 0 };
	struct sensor_value gas_voc = { 0 };
	bool ok;

	sensor_channel_get(weather, SENSOR_CHAN_IAQ, &gas_iaq);
	sensor_channel_get(weather, SENSOR_CHAN_CO2, &gas_co2);
	sensor_channel_get(weather, SENSOR_CHAN_VOC, &gas_voc);
	LOG_DBG("IAQ: %d; CO2: %d.%06d; VOC: %d.%06d",
		gas_iaq.val1, gas_co2.val1, gas_co2.val2, gas_voc.val1, gas_voc.val2);

	ok = zcbor_tstr_put_lit(zse, "iaq") &&
	     zcbor_int32_put(zse, gas_iaq.val1) &&
	     zcbor_tstr_put_lit(zse, "co2") &&
	     zcbor_float64_put(zse, sensor_value_to_double(&gas_co2)) &&
	     zcbor_tstr_put_lit(zse, "voc") &&
	     zcbor_float64_put(zse, sensor_value_to_double(&gas_voc));

	if (!ok)
	{
		LOG_ERR("ZCBOR unable to encode gas data");
		return GOLIOTH_ERR_QUEUE_FULL;
	}

	return GOLIOTH_OK;

#else

	return GOLIOTH_OK;

#endif
}
static enum golioth_status read_weather_sensor(zcbor_state_t *zse)
{
	struct sensor_value temp;
	struct sensor_value press;
	struct sensor_value humidity;
	bool ok;
	enum golioth_status status;

	/* BME680 */
	int err = sensor_sample_fetch(weather);
	if (err) {
		LOG_ERR("Error fetching BME680 sensor sample: %d", err);
		return GOLIOTH_ERR_FAIL;
	}
	sensor_channel_get(weather, SENSOR_CHAN_AMBIENT_TEMP, &temp);
	sensor_channel_get(weather, SENSOR_CHAN_PRESS, &press);
	sensor_channel_get(weather, SENSOR_CHAN_HUMIDITY, &humidity);
	LOG_DBG("T: %d.%06d; P: %d.%06d; H: %d.%06d", temp.val1, abs(temp.val2), press.val1,
		press.val2, humidity.val1, humidity.val2);

	ok = zcbor_tstr_put_lit(zse, "weather") && zcbor_map_start_encode(zse, 4);
	if (!ok)
	{
		LOG_ERR("ZCBOR unable to open weather map");
		return GOLIOTH_ERR_QUEUE_FULL;
	}

	ok = zcbor_tstr_put_lit(zse, "tem") &&
	     zcbor_float64_put(zse, sensor_value_to_double(&temp)) &&
	     zcbor_tstr_put_lit(zse, "pre") &&
	     zcbor_float64_put(zse, sensor_value_to_double(&press)) &&
	     zcbor_tstr_put_lit(zse, "hum") &&
	     zcbor_float64_put(zse, sensor_value_to_double(&humidity));
	if (!ok)
	{
		LOG_ERR("ZCBOR failed to encode weather data");
		return GOLIOTH_ERR_QUEUE_FULL;
	}

	status = process_gas_sensor(zse);
	if (status != GOLIOTH_OK)
	{
		return status;
	}

	ok = zcbor_map_end_encode(zse, 4);
	if (!ok)
	{
		LOG_ERR("ZCBOR failed to close weather map");
		return GOLIOTH_ERR_QUEUE_FULL;
	}

	return GOLIOTH_OK;
}

static enum golioth_status read_accel_sensor(zcbor_state_t *zse)
{
	struct sensor_value accel_x;
	struct sensor_value accel_y;
	struct sensor_value accel_z;
	bool ok;

	/* ADXL362 */
	int err = sensor_sample_fetch(accel);
	if (err) {
		LOG_ERR("Error fetching ADXL362 sensor sample: %d", err);
		return GOLIOTH_ERR_FAIL;
	}
	sensor_channel_get(accel, SENSOR_CHAN_ACCEL_X, &accel_x);
	sensor_channel_get(accel, SENSOR_CHAN_ACCEL_Y, &accel_y);
	sensor_channel_get(accel, SENSOR_CHAN_ACCEL_Z, &accel_z);
	LOG_DBG("X: %d.%06d; Y: %d.%06d; Z: %d.%06d", accel_x.val1, abs(accel_x.val2), accel_y.val1,
		abs(accel_y.val2), accel_z.val1, abs(accel_z.val2));

	ok = zcbor_tstr_put_lit(zse, "accel") && zcbor_map_start_encode(zse, 3);
	if (!ok)
	{
		LOG_ERR("ZCBOR unable to open accel map");
		return GOLIOTH_ERR_QUEUE_FULL;
	}

	ok = zcbor_tstr_put_lit(zse, "x") &&
	     zcbor_float64_put(zse, sensor_value_to_double(&accel_x)) &&
	     zcbor_tstr_put_lit(zse, "y") &&
	     zcbor_float64_put(zse, sensor_value_to_double(&accel_y)) &&
	     zcbor_tstr_put_lit(zse, "z") &&
	     zcbor_float64_put(zse, sensor_value_to_double(&accel_z));
	if (!ok)
	{
		LOG_ERR("ZCBOR failed to encode accel data");
		return GOLIOTH_ERR_QUEUE_FULL;
	}

	ok = zcbor_map_end_encode(zse, 3);
	if (!ok)
	{
		LOG_ERR("ZCBOR failed to close accel map");
		return GOLIOTH_ERR_QUEUE_FULL;
	}

	return GOLIOTH_OK;
}

/* This will be called by the main() loop after delays or on button presses */
/* Do all of your work here! */
void app_sensors_read_and_stream(void)
{
	int err;
	bool ok;
	enum golioth_status status;
	char cbor_buf[256];

	ZCBOR_STATE_E(zse, 3, cbor_buf, sizeof(cbor_buf), 1);

	ok = zcbor_map_start_encode(zse, 3);

	if (!ok)
	{
		LOG_ERR("ZCBOR failed to open map");
		return;
	}

	status = read_light_sensor(zse);
	if (status == GOLIOTH_ERR_QUEUE_FULL)
	{
		return;
	}

	status = read_weather_sensor(zse);
	if (status == GOLIOTH_ERR_QUEUE_FULL)
	{
		return;
	}

	status = read_accel_sensor(zse);
	if (status == GOLIOTH_ERR_QUEUE_FULL)
	{
		return;
	}

	ok = zcbor_map_end_encode(zse, 3);
	if (!ok)
	{
		LOG_ERR("ZCBOR failed to close map");
	}

	size_t cbor_size = zse->payload - (const uint8_t *) cbor_buf;

	/* Only stream sensor data if connected */
	if (golioth_client_is_connected(client)) {
		/* Send to LightDB Stream on "sensor" endpoint */
		err = golioth_stream_set_async(client, "sensor", GOLIOTH_CONTENT_TYPE_CBOR, cbor_buf,
					cbor_size, async_error_handler, NULL);
		if (err) {
			LOG_ERR("Failed to send sensor data to Golioth: %d", err);
		}
	} else {
		LOG_DBG("No connection available, skipping sending data to Golioth");
	}

	/* Only stream sensor data if connected */
	if (golioth_client_is_connected(client)) {
		stream_network_info();
	}
}

void app_sensors_set_client(struct golioth_client *sensors_client)
{
	client = sensors_client;
}
```

## src/app_sensors.h
```c
/*
 * Copyright (c) 2022-2023 Golioth, Inc.
 *
 * SPDX-License-Identifier: Apache-2.0
 */

#ifndef __APP_SENSORS_H__
#define __APP_SENSORS_H__

#include <golioth/client.h>

void app_sensors_set_client(struct golioth_client *sensors_client);
void app_sensors_read_and_stream(void);

#endif /* __APP_SENSORS_H__ */
```

## src/app_settings.c
```c
/*
 * Copyright (c) 2022-2023 Golioth, Inc.
 *
 * SPDX-License-Identifier: Apache-2.0
 */

#include <zephyr/logging/log.h>
#include <sys/_stdint.h>
LOG_MODULE_REGISTER(app_settings, LOG_LEVEL_DBG);

#include <golioth/client.h>
#include <golioth/settings.h>
#include <zephyr/drivers/pwm.h>
#include "main.h"

#include <zephyr/kernel.h>

#include "app_settings.h"

int period = 100000; /* should be 100 uSec */

static int32_t _loop_delay_s = 60;
#define LOOP_DELAY_S_MAX 43200
#define LOOP_DELAY_S_MIN 1
#define LED_FADE_SPEED_MS_MAX 10000
#define LED_FADE_SPEED_MS_MIN 500

enum LED_PCT_CB_INDEX {
	LED_R_CB_ARG,
	LED_G_CB_ARG,
	LED_B_CB_ARG,
};

static int32_t _red_intensity_pct = 50;
static int32_t _green_intensity_pct = 50;
static int32_t _blue_intensity_pct = 50;

static int32_t _led_fade_speed_ms = 1200;

static const struct pwm_dt_spec pwm_led0 = PWM_DT_SPEC_GET(DT_ALIAS(pwm_led0));
static const struct pwm_dt_spec pwm_led1 = PWM_DT_SPEC_GET(DT_ALIAS(pwm_led1));
static const struct pwm_dt_spec pwm_led2 = PWM_DT_SPEC_GET(DT_ALIAS(pwm_led2));

K_SEM_DEFINE(led_pwm_initialized_sem, 0, 1); /* Wait until led pwm is ready */

#define LED_PWM_STACK 4096

static int led_on_off = 1;

float intensity_steps[] = {1.00, 0.95, 0.90, 0.85, 0.80, 0.75, 0.70, 0.65, 0.60, 0.55,
			   0.50, 0.55, 0.60, 0.65, 0.70, 0.75, 0.80, 0.85, 0.90, 0.95};
int array_size = sizeof(intensity_steps) / sizeof(float);

void all_leds_on(void)
{
	led_on_off = 1;
}

void all_leds_off(void)
{
	led_on_off = 0;
}

extern void led_pwm_thread(void *d0, void *d1, void *d2)
{
	/* Block until led pwm is ready */
	k_sem_take(&led_pwm_initialized_sem, K_FOREVER);
	while (1) {
		int ret = 0;
		float pulse_ns = 0;

		for (int i = 0; i < array_size; i++) {
			pulse_ns = (((float)period * (float)_red_intensity_pct *
				     intensity_steps[i] * (float)led_on_off) /
				    100);
			ret = pwm_set_dt(&pwm_led0, period, (int)pulse_ns);
			pulse_ns = (((float)period * (float)_green_intensity_pct *
				     intensity_steps[i] * (float)led_on_off) /
				    100);
			ret = pwm_set_dt(&pwm_led1, period, (int)pulse_ns);
			pulse_ns = (((float)period * (float)_blue_intensity_pct *
				     intensity_steps[i] * (float)led_on_off) /
				    100);
			ret = pwm_set_dt(&pwm_led2, period, (int)pulse_ns);
			/* Sleep thread until next increment of pulsing effect */
			k_sleep(K_MSEC(_led_fade_speed_ms / array_size));
		}
	}
}

int app_led_pwm_init(void)
{
	LOG_DBG("turning on pwm leds");
	k_sem_give(&led_pwm_initialized_sem);
	return 0;
}

K_THREAD_DEFINE(led_pwm_tid, LED_PWM_STACK, led_pwm_thread, NULL, NULL, NULL,
		K_LOWEST_APPLICATION_THREAD_PRIO, 0, 0);

int32_t get_loop_delay_s(void)
{
	return _loop_delay_s;
}

static enum golioth_settings_status on_loop_delay_setting(int32_t new_value, void *arg)
{
	/* Only update if value has changed */
	if (_loop_delay_s == new_value) {
		LOG_DBG("Received LOOP_DELAY_S already matches local value.");
	} else {
		_loop_delay_s = new_value;
		LOG_INF("Set loop delay to %i seconds", _loop_delay_s);

		wake_system_thread();
	}
	return GOLIOTH_SETTINGS_SUCCESS;
}

static enum golioth_settings_status on_fade_speed_setting(int32_t new_value, void *arg)
{
	/* Only update if value has changed */
	if (_led_fade_speed_ms == new_value) {
		LOG_DBG("Received LED_FADE_SPEED_MS already matches local value.");
	}

	else {
		_led_fade_speed_ms = new_value;
		LOG_INF("Set LED fade speed to %d milliseconds", _led_fade_speed_ms);
		/* not waking system thread here, since the LED update thread is looping */
	}
	return GOLIOTH_SETTINGS_SUCCESS;
}

static enum golioth_settings_status on_led_pct_setting(int32_t new_value, void *arg)
{
	int32_t *global_intensity_pct;
	char color_letter;

	switch ((int) arg) {
		case LED_R_CB_ARG:
			global_intensity_pct = &_red_intensity_pct;
			color_letter = 'R';
			break;
		case LED_G_CB_ARG:
			global_intensity_pct = &_green_intensity_pct;
			color_letter = 'G';
			break;
		case LED_B_CB_ARG:
			global_intensity_pct = &_blue_intensity_pct;
			color_letter = 'B';
			break;
		default:
			LOG_ERR("Unexpected LED intensity index value: %i", (int) arg);
			return GOLIOTH_SETTINGS_VALUE_FORMAT_NOT_VALID;
	}

	/* Only update if value has changed */
	if (*global_intensity_pct == new_value) {
		LOG_DBG("Received %c intensity already matches local value.", color_letter);
	} else {
		*global_intensity_pct = new_value;
		LOG_INF("Set %c intensity to %d percent", color_letter, *global_intensity_pct);
		/* not waking system thread here, since the LED update thread is looping */
	}

	return GOLIOTH_SETTINGS_SUCCESS;
}

void check_register_settings_error_and_log(int err, const char *settings_str)
{
	if (err == 0)
	{
		return;
	}


	LOG_ERR("Failed to register settings callback for %s: %d", settings_str, err);
}

void app_settings_register(struct golioth_client *client)
{
	struct golioth_settings *settings = golioth_settings_init(client);
	int err;

	err = golioth_settings_register_int_with_range(settings,
							   "LOOP_DELAY_S",
							   LOOP_DELAY_S_MIN,
							   LOOP_DELAY_S_MAX,
							   on_loop_delay_setting,
							   NULL);

	check_register_settings_error_and_log(err, "LOOP_DELAY_S");

	err = golioth_settings_register_int_with_range(settings,
							   "LED_FADE_SPEED_MS",
							   LED_FADE_SPEED_MS_MIN,
							   LED_FADE_SPEED_MS_MAX,
							   on_fade_speed_setting,
							   NULL);

	check_register_settings_error_and_log(err, "LED_FADE_SPEED_MS");

	err = golioth_settings_register_int_with_range(settings,
							   "RED_INTENSITY_PCT",
							   0,
							   100,
							   on_led_pct_setting,
							   (void *) LED_R_CB_ARG);

	check_register_settings_error_and_log(err, "RED_INTENSITY_PCT");

	err = golioth_settings_register_int_with_range(settings,
							   "GREEN_INTENSITY_PCT",
							   0,
							   100,
							   on_led_pct_setting,
							   (void *) LED_G_CB_ARG);

	check_register_settings_error_and_log(err, "GREEN_INTENSITY_PCT");

	err = golioth_settings_register_int_with_range(settings,
							   "BLUE_INTENSITY_PCT",
							   0,
							   100,
							   on_led_pct_setting,
							   (void *) LED_B_CB_ARG);

	check_register_settings_error_and_log(err, "BLUE_INTENSITY_PCT");
}
```

## src/app_settings.h
```c
/*
 * Copyright (c) 2022-2023 Golioth, Inc.
 *
 * SPDX-License-Identifier: Apache-2.0
 */

#ifndef __APP_SETTINGS_H__
#define __APP_SETTINGS_H__

#include <stdint.h>
#include <golioth/client.h>

int32_t get_loop_delay_s(void);
void app_settings_register(struct golioth_client *client);
int app_led_pwm_init(void);
void all_leds_on(void);
void all_leds_off(void);

#endif /* __APP_SETTINGS_H__ */
```

## src/app_state.c
```c
/*
 * Copyright (c) 2022-2023 Golioth, Inc.
 *
 * SPDX-License-Identifier: Apache-2.0
 */

#include <zephyr/logging/log.h>
LOG_MODULE_REGISTER(app_state, LOG_LEVEL_DBG);

#include <golioth/client.h>
#include <golioth/lightdb_state.h>
#include <zcbor_decode.h>
#include <zcbor_encode.h>
#include <zephyr/data/json.h>
#include <zephyr/kernel.h>

#define APP_STATE_DESIRED_PATH "desired"
#define APP_STATE_ACTUAL_PATH  "state"

K_MUTEX_DEFINE(counter_mutex);
#define COUNTER_UP_STRING "counter_up"
#define COUNTER_DN_STRING "counter_down"
#define COUNTER_MAX 9999
uint16_t _counter_up = COUNTER_MAX;
uint16_t _counter_dn = 0;
bool _initial_update_pending = true;

static struct golioth_client *client;

static void async_handler(struct golioth_client *client,
			  enum golioth_status status,
			  const struct golioth_coap_rsp_code *coap_rsp_code,
			  const char *path,
			  void *arg)
{
	if (status != GOLIOTH_OK) {
		LOG_WRN("Failed to set state: %d", status);
		return;
	}

	LOG_DBG("State successfully set");
}

static bool encode_state(zcbor_state_t *zse, int32_t up, int32_t dn)
{
	bool ok = zcbor_map_start_encode(zse, 2) &&
	          zcbor_tstr_put_lit(zse, COUNTER_UP_STRING) &&
	          zcbor_int32_put(zse, up) &&
	          zcbor_tstr_put_lit(zse, COUNTER_DN_STRING) &&
	          zcbor_int32_put(zse, dn) &&
	          zcbor_map_end_encode(zse, 2);

	return ok;
}

int app_state_reset_desired(void)
{
	bool ok;
	char cbor_buf[64];
	ZCBOR_STATE_E(zse, 1, cbor_buf, sizeof(cbor_buf), 1);

	ok = encode_state(zse, -1, -1);

	if (!ok)
	{
		LOG_ERR("'%s' reset failed while try to encode CBOR.", APP_STATE_DESIRED_PATH);
		return -ENOMEM;
	}

	LOG_INF("Resetting \"%s\" LightDB State endpoint to defaults.", APP_STATE_DESIRED_PATH);

	size_t cbor_size = zse->payload - (const uint8_t *) cbor_buf;

	int err = golioth_lightdb_set_async(client,
					    APP_STATE_DESIRED_PATH,
					    GOLIOTH_CONTENT_TYPE_CBOR,
					    cbor_buf,
					    cbor_size,
					    async_handler,
					    NULL);
	if (err) {
		LOG_ERR("Unable to write to LightDB State: %d", err);
	}

	return err;
}

int app_state_update_actual(void)
{
	bool ok;
	char cbor_buf[64];
	ZCBOR_STATE_E(zse, 1, cbor_buf, sizeof(cbor_buf), 1);

	k_mutex_lock(&counter_mutex, K_FOREVER);
	ok = encode_state(zse, (int32_t) _counter_up, (int32_t) _counter_dn);
	k_mutex_unlock(&counter_mutex);

	if (!ok)
	{
		LOG_ERR("CBOR: failed to encode actual state");
		return -ENOMEM;
	}

	size_t cbor_size = zse->payload - (const uint8_t *) cbor_buf;
	int err = -ENETDOWN;

	if (golioth_client_is_connected(client))
	{
		err = golioth_lightdb_set_async(client,
						APP_STATE_ACTUAL_PATH,
						GOLIOTH_CONTENT_TYPE_CBOR,
						cbor_buf,
						cbor_size,
						async_handler,
						NULL);

		if (err) {
			LOG_ERR("Unable to send actual state to LightDB State: %d", err);
		}
		else if (_initial_update_pending)
		{
			_initial_update_pending = false;
		}
	}
	return err;
}

/// Match a given string with ZCBOR decoded string
///
/// We don't know which order the key/value pairs will be in CBOR. This function takes a string to
/// compare, as well as both key/value pairs. It returns a pointer to the value whose key is a
/// match. If there is no match, NULL will be returned.
///
/// @param to_match String to match against the received key
/// @param zstr0    Pointer to first ZCBOR string
/// @param v0       Pointer to first ZCBOR value
/// @param zstr1    Pointer to second ZCBOR string
/// @param v1       Pointer to second ZCBOR value
///
/// @retval Pointer to int32_t value for the matched key or NULL
static int32_t *find_matching_pointer(const char *to_match, struct zcbor_string *zstr0, int32_t *v0,
				      struct zcbor_string *zstr1, int32_t *v1)
{
	if ((strlen(to_match) == zstr0->len) &&
	    (strncmp(to_match, zstr0->value, zstr0->len) == 0)) {
		return v0;
	}

	if ((strlen(to_match) == zstr1->len) && (strncmp(to_match, zstr1->value, zstr1->len) == 0))
	{
		return v1;
	}

	return NULL;
}

/// Validate and store received value
///
/// @param new_value Value received in CBOR packet
/// @param stored_value Pointer for storing validated value
/// @param str String associated with stored value for use in logging
static void process_desired_value(int32_t new_value, uint16_t *stored_value, const char *str)
{
	if (new_value == -1)
	{
		return;
	}

	if ((new_value < 0) || (new_value > COUNTER_MAX)) {
		LOG_ERR("'%s' server value out of bounds: %u (expected 0..%u)", str, new_value,
			COUNTER_MAX);
		return;
	}

	if (new_value == *stored_value)
	{
		LOG_INF("'%s' server value matches current: %u; ignoring.", str, new_value);

	}
	else
	{
		*stored_value = new_value;
		LOG_INF("Using new '%s' value from server: %u", str, *stored_value);
	}
}

static void app_state_desired_handler(struct golioth_client *client, enum golioth_status status,
				      const struct golioth_coap_rsp_code *coap_rsp_code,
				      const char *path, const uint8_t *payload, size_t payload_size,
				      void *arg)
{
	if (status != GOLIOTH_OK) {
		LOG_ERR("Failed to receive LightDB State '%s' path: %d", APP_STATE_DESIRED_PATH,
			status);
		return;
	}

	if ((payload_size == 1) && (payload[0] == 0xf6))
	{
		/* This is CBOR for NULL */
		LOG_WRN("'%s' path is NULL, resetting.", APP_STATE_DESIRED_PATH);
		goto reset_to_default;
	}

	ZCBOR_STATE_D(zsd, 2, payload, payload_size, 1, 0);

	struct zcbor_string key0;
	struct zcbor_string key1;
	int32_t value0;
	int32_t value1;

	int ok = zcbor_map_start_decode(zsd) &&
		 zcbor_tstr_decode(zsd, &key0) &&
		 zcbor_int32_decode(zsd, &value0) &&
		 zcbor_tstr_decode(zsd, &key1) &&
		 zcbor_int32_decode(zsd, &value1) &&
		 zcbor_map_end_decode(zsd);

	if (!ok)
	{
		LOG_ERR("Decoding failure, deleting path: '%s'", APP_STATE_DESIRED_PATH);
		golioth_lightdb_delete_async(client, APP_STATE_DESIRED_PATH, async_handler, NULL);
		return;
	}

	int32_t *up = find_matching_pointer(COUNTER_UP_STRING, &key0, &value0, &key1, &value1);
	int32_t *dn = find_matching_pointer(COUNTER_DN_STRING, &key0, &value0, &key1, &value1);

	if (!up || !dn)
	{
		LOG_ERR("Did not find expected keys, resetting '%s'", APP_STATE_DESIRED_PATH);
		goto reset_to_default;
	}

	if ((*up == -1) && (*dn == -1))
	{
		/* No changes hae been requested; do nothing */
		goto check_initial_update;
	}

	k_mutex_lock(&counter_mutex, K_FOREVER);
	process_desired_value(*up, &_counter_up, COUNTER_UP_STRING);
	process_desired_value(*dn, &_counter_dn, COUNTER_DN_STRING);
	k_mutex_unlock(&counter_mutex);

	app_state_update_actual();

reset_to_default:
	app_state_reset_desired();

check_initial_update:
	if (_initial_update_pending)
	{
		/* Ensure that actual state is sent at least once after power up */
		app_state_update_actual();
	}
}

int app_state_counter_change(void)
{
	k_mutex_lock(&counter_mutex, K_FOREVER);

	if (++_counter_up > COUNTER_MAX)
	{
		_counter_up = 0;
	}

	if (--_counter_dn > COUNTER_MAX)
	{
		_counter_dn = COUNTER_MAX;
	}

	LOG_DBG("D: %d; U: %d", _counter_dn, _counter_up);

	k_mutex_unlock(&counter_mutex);

	return app_state_update_actual();
}

int app_state_observe(struct golioth_client *state_client)
{
	client = state_client;

	int err = golioth_lightdb_observe_async(client,
						APP_STATE_DESIRED_PATH,
						GOLIOTH_CONTENT_TYPE_CBOR,
						app_state_desired_handler,
						NULL);
	if (err) {
		LOG_WRN("failed to observe lightdb path: %d", err);
		return err;
	}

	return err;
}
```

## src/app_state.h
```c
/*
 * Copyright (c) 2022-2023 Golioth, Inc.
 *
 * SPDX-License-Identifier: Apache-2.0
 */

#ifndef __APP_STATE_H__
#define __APP_STATE_H__

#include <golioth/client.h>

int app_state_observe(struct golioth_client *state_client);
int app_state_counter_change(void);

#endif /* __APP_STATE_H__ */
```

## src/app_work.h
```c
/*
 * Copyright (c) 2022-2023 Golioth, Inc.
 *
 * SPDX-License-Identifier: Apache-2.0
 */

#ifndef __APP_WORK_H__
#define __APP_WORK_H__

#include <net/golioth/system_client.h>

void app_work_init(struct golioth_client *work_client);
void app_work_sensor_read(void);

int app_buzzer_init(void);
void play_funkytown_once(void);
void play_mario_once(void);
void play_beep_once(void);
void play_golioth_once(void);

#define BUZZER_MAX_FREQ 2500
#define BUZZER_MIN_FREQ 75

#define sixteenth 38
#define eigth	  75
#define quarter	  150
#define half	  300
#define whole	  600

#define C4  262
#define Db4 277
#define D4  294
#define Eb4 311
#define E4  330
#define F4  349
#define Gb4 370
#define G4  392
#define Ab4 415
#define A4  440
#define Bb4 466
#define B4  494
#define C5  523
#define Db5 554
#define D5  587
#define Eb5 622
#define E5  659
#define F5  698
#define Gb5 740
#define G5  784
#define Ab5 831
#define A5  880
#define Bb5 932
#define B5  988
#define C6  1046
#define Db6 1109
#define D6  1175
#define Eb6 1245
#define E6  1319
#define F6  1397
#define Gb6 1480
#define G6  1568
#define Ab6 1661
#define A6  1760
#define Bb6 1865
#define B6  1976

#define REST 1

#endif /* __APP_WORK_H__ */
```
